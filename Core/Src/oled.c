#include "oled.h"

/* ==================================================================
 * 一、软件模拟 I2C（SCL=PB6，SDA=PB7）
 * ================================================================== */

/* I2C 从机地址：0x3C 左移一位 = 0x78（写操作） */
#define OLED_ADDR   0x78

/* 引脚操作宏：直接写端口和引脚号，不依赖 CubeMX 的标签 */
#define OLED_SCL_HIGH()   HAL_GPIO_WritePin(GPIOB, GPIO_PIN_6, GPIO_PIN_SET)
#define OLED_SCL_LOW()    HAL_GPIO_WritePin(GPIOB, GPIO_PIN_6, GPIO_PIN_RESET)
#define OLED_SDA_HIGH()   HAL_GPIO_WritePin(GPIOB, GPIO_PIN_7, GPIO_PIN_SET)
#define OLED_SDA_LOW()    HAL_GPIO_WritePin(GPIOB, GPIO_PIN_7, GPIO_PIN_RESET)

/*
 * 简单延时：用 for 循环凑出几个微秒，不追求精确
 * volatile 防止编译器把空循环优化掉
 */
static void I2C_Delay(void)
{
    volatile uint16_t i;
    for (i = 0; i < 30; i++)
    {
        __NOP();
    }
}

/* I2C 起始信号：SCL 高电平期间，SDA 由高变低 */
static void I2C_Start(void)
{
    OLED_SDA_HIGH();
    OLED_SCL_HIGH();
    I2C_Delay();
    OLED_SDA_LOW();
    I2C_Delay();
    OLED_SCL_LOW();
    I2C_Delay();
}

/* I2C 停止信号：SCL 高电平期间，SDA 由低变高 */
static void I2C_Stop(void)
{
    OLED_SCL_LOW();
    OLED_SDA_LOW();
    I2C_Delay();
    OLED_SCL_HIGH();
    I2C_Delay();
    OLED_SDA_HIGH();
    I2C_Delay();
}

/* 写一个字节：高位先发（MSB First），第 9 个时钟留作 ACK */
static void I2C_WriteByte(uint8_t dat)
{
    uint8_t i;

    for (i = 0; i < 8; i++)
    {
        if (dat & 0x80)
            OLED_SDA_HIGH();
        else
            OLED_SDA_LOW();

        dat <<= 1;
        I2C_Delay();

        OLED_SCL_HIGH();      /* SCL 拉高，从机采样 SDA */
        I2C_Delay();
        OLED_SCL_LOW();       /* SCL 拉低，准备下一位   */
        I2C_Delay();
    }

    /* 第 9 个时钟：释放 SDA，等待从机拉低应答（这里不判断，直接放行） */
    OLED_SDA_HIGH();
    I2C_Delay();
    OLED_SCL_HIGH();
    I2C_Delay();
    OLED_SCL_LOW();
    I2C_Delay();
}

/* 向 OLED 写命令：控制字节 0x00 表示后面是命令 */
static void OLED_WriteCmd(uint8_t cmd)
{
    I2C_Start();
    I2C_WriteByte(OLED_ADDR);
    I2C_WriteByte(0x00);
    I2C_WriteByte(cmd);
    I2C_Stop();
}

/* 向 OLED 写数据：控制字节 0x40 表示后面是显存数据 */
static void OLED_WriteData(uint8_t dat)
{
    I2C_Start();
    I2C_WriteByte(OLED_ADDR);
    I2C_WriteByte(0x40);
    I2C_WriteByte(dat);
    I2C_Stop();
}

/* ==================================================================
 * 二、GPIO 初始化（PB6/PB7 推挽/开漏输出）
 * ================================================================== */
static void OLED_GPIO_Init(void)
{
    GPIO_InitTypeDef GPIO_InitStruct = {0};

    __HAL_RCC_GPIOB_CLK_ENABLE();          /* 打开 GPIOB 时钟 */

    GPIO_InitStruct.Pin   = GPIO_PIN_6 | GPIO_PIN_7;
    GPIO_InitStruct.Mode  = GPIO_MODE_OUTPUT_OD;   /* 开漏输出，符合 I2C 总线要求 */
    GPIO_InitStruct.Pull  = GPIO_PULLUP;
    GPIO_InitStruct.Speed = GPIO_SPEED_FREQ_HIGH;
    HAL_GPIO_Init(GPIOB, &GPIO_InitStruct);

    /* 总线空闲时两根线都保持高电平 */
    OLED_SCL_HIGH();
    OLED_SDA_HIGH();
}

/* ==================================================================
 * 三、OLED 初始化（SSD1306 标准命令序列）
 * ================================================================== */
void OLED_Init(void)
{
    OLED_GPIO_Init();

    HAL_Delay(100);                 /* 等 OLED 上电稳定 */

    OLED_WriteCmd(0xAE);            /* 关闭显示                 */

    OLED_WriteCmd(0xD5);            /* 设置时钟分频             */
    OLED_WriteCmd(0x80);

    OLED_WriteCmd(0xA8);            /* 设置复用率 = 64 行       */
    OLED_WriteCmd(0x3F);

    OLED_WriteCmd(0xD3);            /* 设置显示偏移 = 0         */
    OLED_WriteCmd(0x00);

    OLED_WriteCmd(0x40);            /* 显示起始行 = 0           */

    OLED_WriteCmd(0x8D);            /* 电荷泵使能               */
    OLED_WriteCmd(0x14);

    OLED_WriteCmd(0x20);            /* 内存寻址模式：水平寻址   */
    OLED_WriteCmd(0x00);

    OLED_WriteCmd(0xA1);            /* 段重映射（左右方向）     */
    OLED_WriteCmd(0xC8);            /* 行扫描方向（上下方向）   */

    OLED_WriteCmd(0xDA);            /* COM 引脚配置             */
    OLED_WriteCmd(0x12);

    OLED_WriteCmd(0x81);            /* 对比度                   */
    OLED_WriteCmd(0xCF);

    OLED_WriteCmd(0xD9);            /* 预充电周期               */
    OLED_WriteCmd(0xF1);

    OLED_WriteCmd(0xDB);            /* VCOMH 电压               */
    OLED_WriteCmd(0x40);

    OLED_WriteCmd(0xA4);            /* 按显存内容显示           */
    OLED_WriteCmd(0xA6);            /* 正常显示（非反白）       */

    OLED_WriteCmd(0xAF);            /* 打开显示                 */

    OLED_Clear();                   /* 清屏，防止上电随机雪花   */
}

/* ==================================================================
 * 四、清屏
 * ================================================================== */
void OLED_Clear(void)
{
    uint8_t page, col;

    for (page = 0; page < 8; page++)
    {
        OLED_WriteCmd(0xB0 + page);      /* 选中第 page 页      */
        OLED_WriteCmd(0x00);             /* 列地址低 4 位 = 0   */
        OLED_WriteCmd(0x10);             /* 列地址高 4 位 = 0   */

        for (col = 0; col < OLED_WIDTH; col++)
        {
            OLED_WriteData(0x00);        /* 每个字节 0 = 不亮   */
        }
    }
}

/* ==================================================================
 * 五、显示字符 / 字符串 / 数字
 * ================================================================== */

/* 6x8 ASCII 字库：从 空格(0x20) 到 ~(0x7E)，共 95 个字符 */
static const uint8_t F6x8[][6] = {
    {0x00,0x00,0x00,0x00,0x00,0x00}, /* 空格 */
    {0x00,0x00,0x00,0x2F,0x00,0x00}, /* ! */
    {0x00,0x00,0x07,0x00,0x07,0x00}, /* " */
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    {0x00,0x08,0x04,0x08,0x10,0x08}, /* ~ */
};

void OLED_ShowChar(uint8_t x, uint8_t y, char ch)
{
    uint8_t i;
    uint8_t index;

    if (y > 7) return;                    /* 页号越界保护 */
    if (x > (OLED_WIDTH - 6)) return;      /* 横向越界保护 */

    /* 只支持可显示 ASCII 字符，其它字符用空格代替 */
    if (ch < ' ' || ch > '~')
        ch = ' ';

    index = (uint8_t)(ch - ' ');          /* 字库下标 */

    OLED_WriteCmd(0xB0 + y);              /* 选中页       */
    OLED_WriteCmd(0x00 | (x & 0x0F));     /* 列低 4 位    */
    OLED_WriteCmd(0x10 | (x >> 4));       /* 列高 4 位    */

    for (i = 0; i < 6; i++)
    {
        OLED_WriteData(F6x8[index][i]);   /* 逐列写 6 个字节 */
    }
}

void OLED_ShowString(uint8_t x, uint8_t y, const char *str)
{
    while (*str != '\0')
    {
        if (x > (OLED_WIDTH - 6))         /* 一行放不下就停止，防止越界 */
            break;

        OLED_ShowChar(x, y, *str);
        x += 6;
        str++;
    }
}

void OLED_ShowNum(uint8_t x, uint8_t y, uint32_t num, uint8_t len)
{
    uint8_t i;

    if (len == 0) return;

    /* 从最低位开始，依次往左放 */
    for (i = 0; i < len; i++)
    {
        OLED_ShowChar(x + (len - 1 - i) * 6, y, (char)('0' + num % 10));
        num /= 10;
    }
}
